## src/components/erpc/Kconfig
```kconfig
menu "ESP32-eRPC"

    choice ERPC_THREADS
        prompt "Threading model used by eRPC"
        default ERPC_THREADS_PTHREADS
        config ERPC_THREADS_NONE
            bool
            prompt "No threading"
        config ERPC_THREADS_PTHREADS
            bool
            prompt "Pthreads"
    endchoice # ERPC_THREADS

    config ERPC_DEFAULT_BUFFER_SIZE
        int "Size of each message"
        range 1 4294967295
        default 256
        help
            Size of buffers allocated by one of MessageBufferFactory. In
            other words size of each message.

    config ERPC_DEFAULT_BUFFERS_COUNT
        int "Number of concurrent messages"
        range 1 4294967295
        default 2
        help
            Number of message buffers

endmenu # ESP32-eRPC
```

## src/examples/connection/sdkconfig.defaults
```kconfig
CONFIG_ERPC_DEFAULT_BUFFERS_COUNT=8

# Print and halt.
# Print and reboot is not handy to work with.
CONFIG_ESP_SYSTEM_PANIC_PRINT_HALT=y

CONFIG_BOOTLOADER_LOG_LEVEL_WARN=y
CONFIG_BOOTLOADER_LOG_LEVEL=2

CONFIG_LOG_DEFAULT_LEVEL_INFO=y
CONFIG_LOG_DEFAULT_LEVEL=3

CONFIG_FREERTOS_HZ=1000

CONFIG_ESP_CONSOLE_UART_CUSTOM=y
CONFIG_ESP_CONSOLE_UART_CUSTOM_NUM_0=y
CONFIG_ESP_CONSOLE_UART_BAUDRATE=2000000
```

## src/examples/esp_log/sdkconfig.defaults
```kconfig
CONFIG_ESP32S3_DEFAULT_CPU_FREQ_240=y
CONFIG_ESP32S3_DEFAULT_CPU_FREQ_MHZ=240
CONFIG_UART_ISR_IN_IRAM=y

# Print and halt.
# Print and reboot is not handy to work with.
CONFIG_ESP_SYSTEM_PANIC_PRINT_HALT=y

CONFIG_FREERTOS_HZ=1000

CONFIG_ESP_CONSOLE_UART_CUSTOM=y
CONFIG_ESP_CONSOLE_UART_CUSTOM_NUM_0=y
CONFIG_ESP_CONSOLE_UART_BAUDRATE=2000000
CONFIG_ESPTOOLPY_MONITOR_BAUD_CONSOLE=y
```

## src/examples/hello_world/sdkconfig.defaults
```kconfig
# Print and halt.
# Print and reboot is not handy to work with.
CONFIG_ESP_SYSTEM_PANIC_PRINT_HALT=y
```
